## firmware/esp-idf/main/Kconfig.projbuild
```kconfig
menu "Huginn image role"

choice HUGINN_IMAGE_ROLE
    prompt "Image role"
    default HUGINN_IMAGE_ROLE_BASE
    help
        Select the role compiled into this image. Both images are serial-only
        and contain no owner configuration or network credentials.

config HUGINN_IMAGE_ROLE_BASE
    bool "Base image"

config HUGINN_IMAGE_ROLE_RECOVERY
    bool "Recovery image"

endchoice

endmenu

menu "Huginn board profile"

config HUGINN_BOARD_PROFILE_HELTEC_WIFI_LORA_32_V3
    bool "Heltec WiFi LoRa 32 V3"
    default y
    help
        Select the verified Heltec WiFi LoRa 32 V3 board profile. This profile
        records only documented candidate wiring and does not enable radio,
        network, display-rendering, or indicator behavior.

config HUGINN_DISPLAY_PROBE
    bool "Bounded Heltec V3 display I2C probe"
    depends on HUGINN_BOARD_PROFILE_HELTEC_WIFI_LORA_32_V3
    help
        Configure the documented OLED I2C pins and scan the bus for address
        acknowledgements. The probe does not drive OLED power, reset, or the
        status LED, and it does not assume an OLED address or electrical
        polarity. No acknowledgement is reported as a valid probe outcome.

config HUGINN_OLED_CONSOLE
    bool "Heltec V3 OLED operational console"
    depends on HUGINN_BOARD_PROFILE_HELTEC_WIFI_LORA_32_V3
    help
        Enable the verified V3 OLED power, reset, address discovery, and
        status-console renderer in the base image. The console reports only
        local, verified bring-up state; it does not enable radios, networking,
        remote control, or credentials.

endmenu
```

## firmware/esp-idf/sdkconfig.defaults
```kconfig
CONFIG_IDF_TARGET="esp32s3"
CONFIG_ESPTOOLPY_FLASHSIZE_8MB=y
CONFIG_ESPTOOLPY_FLASHMODE_DIO=y
CONFIG_ESPTOOLPY_FLASHFREQ_80M=y
CONFIG_SPIRAM=n
CONFIG_ESP_CONSOLE_NONE=y
CONFIG_LOG_DEFAULT_LEVEL_INFO=y
CONFIG_PARTITION_TABLE_SINGLE_APP=y
CONFIG_COMPILER_OPTIMIZATION_SIZE=y
```
